#include "common-nrf52840.overlay"

/*
 * The following is needed only for using the WNCM M14A2A modem.
 * FIXME: clean this up.
 */
&uart1 {
	current-speed = <115200>;
	status = "ok";
	tx-pin = <46>;
	rx-pin = <45>;
	rts-pin = <44>;
	cts-pin = <47>;

	wncm14a2a {
		compatible = "wnc,m14a2a";
		label = "wncm14a2a";
		mdm-boot-mode-sel-gpios = <&gpio1 2 0>;
		mdm-power-gpios = <&gpio1 3 0>;
		mdm-keep-awake-gpios = <&gpio1 7 0>;
		mdm-reset-gpios = <&gpio1 10 0>;
		mdm-shld-trans-ena-gpios = <&gpio1 11 0>;
		status = "ok";
	};
};
