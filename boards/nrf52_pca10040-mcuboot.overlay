/*
 * Override the default flash partitions for MCUboot.
 *
 * We need more flash for the DTLS use case,
 * so use the nrf52_blenano2 partitions. This
 * is done unconditionally mostly just to keep
 * different builds consistent, which coincidentally
 * makes things easier for CI.
 */
&boot_partition {
	reg = <0x00000000 0x8000>;
};
&slot0_partition {
	reg = <0x00008000 0x34000>;
};
&slot1_partition {
	reg = <0x0003c000 0x34000>;
};
&scratch_partition {
	reg = <0x00070000 0xD000>;
};
