## boards/96b_nitrogen.conf
```kconfig
# network stack settings
CONFIG_NET_IF_UNICAST_IPV6_ADDR_COUNT=3
CONFIG_NET_IF_MCAST_IPV6_ADDR_COUNT=2

# bluetooth settings
CONFIG_BT_RX_BUF_COUNT=10
CONFIG_BT_RX_BUF_LEN=128
CONFIG_BT_CTLR_RX_BUFFERS=6
CONFIG_BT_CTLR_TX_BUFFERS=7
CONFIG_BT_RX_STACK_SIZE=2048
CONFIG_BT_L2CAP_TX_BUF_COUNT=6

# HW settings
CONFIG_TEXT_SECTION_OFFSET=0x100

# temp settings
CONFIG_TEMP_NRF5_NAME="fota-mcu-temp"

# Default IP configuration for IPv6 (gateway)
CONFIG_NET_APP_PEER_IPV6_ADDR="fe80::d4e7:0:0:1"

# LWM2M (gateway)
CONFIG_LWM2M_FIRMWARE_UPDATE_PULL_COAP_PROXY_ADDR="fe80::d4e7:0:0:1"
```

## boards/frdm_k64f.conf
```kconfig
# network stack settings
CONFIG_NET_IF_UNICAST_IPV4_ADDR_COUNT=3
CONFIG_NET_IF_MCAST_IPV4_ADDR_COUNT=2
CONFIG_NET_ARP_TABLE_SIZE=10

# Use FXOS8700 as "mcu-temp" temperature sensor.
CONFIG_SENSOR=y
CONFIG_I2C=y
CONFIG_FXOS8700=y
CONFIG_FXOS8700_MODE_HYBRID=y
CONFIG_FXOS8700_TEMP=y
CONFIG_FXOS8700_TRIGGER_GLOBAL_THREAD=y

# LED GPIO on K64F is inverted
CONFIG_FOTA_LED_GPIO_INVERTED=y
```

## boards/nrf52_pca10040.conf
```kconfig
CONFIG_NET_L2_BT=y

# network stack settings
CONFIG_NET_IF_UNICAST_IPV6_ADDR_COUNT=3
CONFIG_NET_IF_MCAST_IPV6_ADDR_COUNT=2
CONFIG_NET_APP_INIT_TIMEOUT=0

# bluetooth settings
CONFIG_BT_RX_BUF_COUNT=10
CONFIG_BT_RX_BUF_LEN=128
CONFIG_BT_CTLR_RX_BUFFERS=6
CONFIG_BT_CTLR_TX_BUFFERS=7
CONFIG_BT_RX_STACK_SIZE=2048
CONFIG_BT_L2CAP_TX_BUF_COUNT=6

# Default IP configuration for IPv6 (gateway)
CONFIG_NET_APP_PEER_IPV6_ADDR="fe80::d4e7:0:0:1"

# LWM2M (gateway)
CONFIG_LWM2M_FIRMWARE_UPDATE_PULL_COAP_PROXY_ADDR="coap://[fe80::d4e7:0:0:1]:5682"

# We don't use the upstream flash storage partition, and need the
# flash space for our application.
# CONFIG_FS_FLASH_STORAGE_PARTITION is not set
```

## network_defaults/Kconfig.defaults.ble6lowpan
```kconfig
config BT
	default y

config BT_CTLR
	default y

config NET_L2_BT
	default y

config NET_CONFIG_BT_NODE
	default y

config BT_DEVICE_NAME
	default "ZMP IPSP node"

# Need time for RADVD settings
config NET_CONFIG_INIT_TIMEOUT
	default 30

config BT_RX_BUF_COUNT
	default 10

config BT_RX_BUF_LEN
	default 128

config BT_CTLR_RX_BUFFERS
	default 6

config BT_CTLR_TX_BUFFERS
	default 7

config BT_RX_STACK_SIZE
	default 2048

config BT_L2CAP_TX_BUF_COUNT
	default 6

config BT_SMP
	default y

config BT_PERIPHERAL
	default y

config BT_CENTRAL
	default y

config BT_L2CAP_DYNAMIC_CHANNEL
	default y

# The following BT configs are not needed in peripheral mode.

config BT_CTLR_CONN_PARAM_REQ
	default n

config BT_CTLR_ADV_EXT
	default n

# Network settings

config NET_CONFIG_INIT_TIMEOUT
	default 30

config NET_IF_UNICAST_IPV6_ADDR_COUNT
	default 3

config NET_IF_MCAST_IPV6_ADDR_COUNT
	default 2

config DNS_SERVER1
	default "fd11:11::1"

config LWM2M_FIRMWARE_UPDATE_PULL_COAP_PROXY_SUPPORT
	default y

config LWM2M_FIRMWARE_UPDATE_PULL_COAP_PROXY_ADDR
	default "coap://[fd11:11::1]:5682"
```

## network_defaults/Kconfig.defaults.ieee802154
```kconfig
config IEEE802154
	default y

config NET_L2_IEEE802154
	default y

config NET_L2_IEEE802154_SHELL
	default y

# Network settings

config NET_CONFIG_INIT_TIMEOUT
	default 30

config NET_IF_UNICAST_IPV6_ADDR_COUNT
	default 3

config NET_IF_MCAST_IPV6_ADDR_COUNT
	default 2

config DNS_SERVER1
	default "fd11:33::1"

config LWM2M_FIRMWARE_UPDATE_PULL_COAP_PROXY_SUPPORT
	default y

config LWM2M_FIRMWARE_UPDATE_PULL_COAP_PROXY_ADDR
	default "coap://[fd11:33::1]:5682"
```

## network_defaults/Kconfig.defaults.modem
```kconfig
config MODEM
	default y

config MODEM_SHELL
	default y

# Avoid having to set a local IP for the modem
config NET_CONFIG_MY_IPV4_ADDR
	default "192.168.0.1"

# extend retry timing to 20 seconds for LTE/LTE-M
config COAP_INIT_ACK_TIMEOUT_MS
	default 20000
```

## network_defaults/Kconfig.defaults.ot
```kconfig
config NET_L2_OPENTHREAD
	default y

# Enable C++ for OpenThread stack compilation
config CPLUSPLUS
	default y

# Enable flash page layout extension
config FLASH_PAGE_LAYOUT
	default y

# OpenThread requires larger stack sizes

config MAIN_STACK_SIZE
	default 2048

config NET_TX_STACK_SIZE
	default 2048

# Network settings

# OpenThread doesn't use NS/NA
config NET_IPV6_NBR_CACHE
	default n
config NET_IPV6_MLD
	default n

config NET_CONFIG_INIT_TIMEOUT
	default 90

config NET_IF_UNICAST_IPV6_ADDR_COUNT
	default 6

config NET_IF_MCAST_IPV6_ADDR_COUNT
	default 8

config DNS_SERVER1
	default "fd11:22::1"

config LWM2M_FIRMWARE_UPDATE_PULL_COAP_PROXY_SUPPORT
	default y

config LWM2M_FIRMWARE_UPDATE_PULL_COAP_PROXY_ADDR
	default "coap://[fd11:22::1]:5682"
```
