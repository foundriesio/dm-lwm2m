/* We need to share partitions with MCUboot. */
#include "./nrf52_pca10040-mcuboot.overlay"

/* Additional partitions managed by this application: */
&flash0 {
	partitions {
		/* Persistent state the application modifies. */
		app_state_partition: partition@7d000 {
			label = "application-state";
			reg = <0x0007d000 0x2000>;
		};

		/* DTLS credentials etc. */
		credentials_partition: partition@7f000 {
			label = "lwm2m-credentials";
			reg = <0x0007f000 0x1000>;
		};
	};
};
